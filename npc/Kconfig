## npc/Kconfig
```kconfig
mainmenu "RISC-V CPU Simulator (NPC) Configuration"

config FAST_SIM
    bool "Prefer minimal high-speed simulation defaults"
    default n
    help
      Use this as a reminder/profile knob for a lean simulator setup. Disable
      trace, difftest, watchpoints, interactive SDB, and retire tracing for the
      fastest run loop.

config TRACE
    bool "Enable Tracing Features (Master Switch)"
    default y if !FAST_SIM
    default n if FAST_SIM
    help
      Enable this to turn on all tracing sub-features. This is the
      master switch for itrace, ftrace, and other potential traces.
      Disabling this will turn off all tracing code compilation for
      maximum performance.

if TRACE

    config DISASM
        bool "Enable instruction disassembler"
        default y if ITRACE
        help
          Link Capstone and enable disassembly helpers. This is normally only
          useful with itrace.

    config ITRACE
        bool "Enable Instruction Trace (itrace)"
        depends on RETIRE_TRACE
        select DISASM
        default y
        help
          Logs every instruction executed by the CPU, including its disassembly.
          This requires the Capstone disassembly library. This can generate
          very large log files and has a noticeable performance impact.

    config FTRACE
        bool "Enable Function Trace (ftrace)"
        depends on RETIRE_TRACE
        default y
        help
          Tracks function calls and returns using symbols from an ELF file.
          This requires providing an ELF file at runtime and links against
          libelf.

    config MTRACE
        bool "Enable Memory Trace (mtrace)"
        default n
        help
          Logs every memory read and write operation. This is extremely
          verbose and will severely impact simulation speed. Use only for
          debugging specific memory issues.

    config DTRACE
        bool "Enable Device Trace (dtrace)"
        default n
        help
          Logs interactions with memory-mapped devices like the serial
          port or timer. Less verbose than full mtrace.
    

    config PCTRACE
        bool "Enable PC fetch Trace"
        depends on RETIRE_TRACE
        default n

endif # TRACE

config RETIRE_TRACE
    bool "Enable retire-state DPI tracking"
    default y if TRACE && !FAST_SIM
    default n if FAST_SIM
    help
      Maintain architectural state from the retire DPI callback. Difftest,
      instruction-level stepping, watchpoints, itrace, ftrace, and checking
      ebreak's a0 value need this. Disable for the minimal clk/memory/ebreak
      simulation path.

config DIFFTEST
    bool "Enable Differential Testing"
    depends on RETIRE_TRACE
    default n
    help
      Compare the execution of the DUT (this simulator) against
      a reference implementation (e.g., NEMU) on every step. This is
      a powerful verification tool but requires the reference to be built.

config INTERACTIVE_SDB
    bool "Enable interactive SDB monitor"
    default y if !FAST_SIM
    default n if FAST_SIM
    help
      Enable readline-based commands such as si, info, x, p, watchpoints, and
      backtrace. Disable for batch-only high-speed runs.

config LOG_FLUSH_EACH_WRITE
    bool "Flush log files after every write"
    default y
    help
      Useful when debugging crashes, but expensive with verbose traces.

config WATCHPOINT
    bool "Enable Watchpoints"
    depends on INTERACTIVE_SDB && RETIRE_TRACE
    default y if !FAST_SIM
    default n if FAST_SIM
```
